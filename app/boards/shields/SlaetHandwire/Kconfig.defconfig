## app/boards/shields/SlaetHandwire/Kconfig.defconfig
```kconfig
if SHIELD_SLAET-Handwire_LEFT

config ZMK_KEYBOARD_NAME
    default "Slaet-Handwire"

config ZMK_SPLIT_ROLE_CENTRAL
    default y

endif

if SHIELD_SLAET-Handwire_LEFT || SHIELD_SLAET-Handwire_RIGHT

config ZMK_SPLIT
    default y

endif
```

## app/boards/shields/SlaetHandwire/Kconfig.shield
```kconfig
# Copyright (c) 2025 Slaet
# SPDX-License-Identifier: MIT

config SHIELD_SlaetHandwire_left
    def_bool $(shields_list_contains,SlaetHandwire_left)

config SHIELD_SlaetHandwire_right
    def_bool $(shields_list_contains,SlaetHandwire_right)
```
